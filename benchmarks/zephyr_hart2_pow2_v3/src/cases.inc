/* Generated from source-only cases.py; frozen before timing labels. */
static const group_t groups[486]={
{0,8,1,0,0,17,1,0,0},
{0,8,1,0,0,17,1,1,1},
{0,8,1,0,0,17,1,2,2},
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{1,8,1,32,4,65,3,2,646},
};
static const descriptor_t descriptors[648]={
{0,0,0,32,32,1},
{1,0,48,32,32,1},
{2,0,96,32,32,1},
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{485,1,685936,4096,1024,4},
};
static const char*const case_ids[486]={
"zephyr.pow2.v1.rvv.e8.m1.n17.mask1.trial0",
"zephyr.pow2.v1.rvv.e8.m1.n17.mask1.trial1",
"zephyr.pow2.v1.rvv.e8.m1.n17.mask1.trial2",
"zephyr.pow2.v1.rvv.e8.m1.n17.mask2.trial0",
"zephyr.pow2.v1.rvv.e8.m1.n17.mask2.trial1",
"zephyr.pow2.v1.rvv.e8.m1.n17.mask2.trial2",
"zephyr.pow2.v1.rvv.e8.m1.n17.mask3.trial0",
"zephyr.pow2.v1.rvv.e8.m1.n17.mask3.trial1",
"zephyr.pow2.v1.rvv.e8.m1.n17.mask3.trial2",
"zephyr.pow2.v1.rvv.e8.m1.n65.mask1.trial0",
"zephyr.pow2.v1.rvv.e8.m1.n65.mask1.trial1",
"zephyr.pow2.v1.rvv.e8.m1.n65.mask1.trial2",
"zephyr.pow2.v1.rvv.e8.m1.n65.mask2.trial0",
"zephyr.pow2.v1.rvv.e8.m1.n65.mask2.trial1",
"zephyr.pow2.v1.rvv.e8.m1.n65.mask2.trial2",
"zephyr.pow2.v1.rvv.e8.m1.n65.mask3.trial0",
"zephyr.pow2.v1.rvv.e8.m1.n65.mask3.trial1",
"zephyr.pow2.v1.rvv.e8.m1.n65.mask3.trial2",
"zephyr.pow2.v1.rvv.e8.m2.n17.mask1.trial0",
"zephyr.pow2.v1.rvv.e8.m2.n17.mask1.trial1",
"zephyr.pow2.v1.rvv.e8.m2.n17.mask1.trial2",
"zephyr.pow2.v1.rvv.e8.m2.n17.mask2.trial0",
"zephyr.pow2.v1.rvv.e8.m2.n17.mask2.trial1",
"zephyr.pow2.v1.rvv.e8.m2.n17.mask2.trial2",
"zephyr.pow2.v1.rvv.e8.m2.n17.mask3.trial0",
"zephyr.pow2.v1.rvv.e8.m2.n17.mask3.trial1",
"zephyr.pow2.v1.rvv.e8.m2.n17.mask3.trial2",
"zephyr.pow2.v1.rvv.e8.m2.n65.mask1.trial0",
"zephyr.pow2.v1.rvv.e8.m2.n65.mask1.trial1",
"zephyr.pow2.v1.rvv.e8.m2.n65.mask1.trial2",
"zephyr.pow2.v1.rvv.e8.m2.n65.mask2.trial0",
"zephyr.pow2.v1.rvv.e8.m2.n65.mask2.trial1",
"zephyr.pow2.v1.rvv.e8.m2.n65.mask2.trial2",
"zephyr.pow2.v1.rvv.e8.m2.n65.mask3.trial0",
"zephyr.pow2.v1.rvv.e8.m2.n65.mask3.trial1",
"zephyr.pow2.v1.rvv.e8.m2.n65.mask3.trial2",
"zephyr.pow2.v1.rvv.e8.m4.n17.mask1.trial0",
"zephyr.pow2.v1.rvv.e8.m4.n17.mask1.trial1",
"zephyr.pow2.v1.rvv.e8.m4.n17.mask1.trial2",
"zephyr.pow2.v1.rvv.e8.m4.n17.mask2.trial0",
"zephyr.pow2.v1.rvv.e8.m4.n17.mask2.trial1",
"zephyr.pow2.v1.rvv.e8.m4.n17.mask2.trial2",
"zephyr.pow2.v1.rvv.e8.m4.n17.mask3.trial0",
"zephyr.pow2.v1.rvv.e8.m4.n17.mask3.trial1",
"zephyr.pow2.v1.rvv.e8.m4.n17.mask3.trial2",
"zephyr.pow2.v1.rvv.e8.m4.n65.mask1.trial0",
"zephyr.pow2.v1.rvv.e8.m4.n65.mask1.trial1",
"zephyr.pow2.v1.rvv.e8.m4.n65.mask1.trial2",
"zephyr.pow2.v1.rvv.e8.m4.n65.mask2.trial0",
"zephyr.pow2.v1.rvv.e8.m4.n65.mask2.trial1",
"zephyr.pow2.v1.rvv.e8.m4.n65.mask2.trial2",
"zephyr.pow2.v1.rvv.e8.m4.n65.mask3.trial0",
"zephyr.pow2.v1.rvv.e8.m4.n65.mask3.trial1",
"zephyr.pow2.v1.rvv.e8.m4.n65.mask3.trial2",
"zephyr.pow2.v1.rvv.e8.m8.n17.mask1.trial0",
"zephyr.pow2.v1.rvv.e8.m8.n17.mask1.trial1",
"zephyr.pow2.v1.rvv.e8.m8.n17.mask1.trial2",
"zephyr.pow2.v1.rvv.e8.m8.n17.mask2.trial0",
"zephyr.pow2.v1.rvv.e8.m8.n17.mask2.trial1",
"zephyr.pow2.v1.rvv.e8.m8.n17.mask2.trial2",
"zephyr.pow2.v1.rvv.e8.m8.n17.mask3.trial0",
"zephyr.pow2.v1.rvv.e8.m8.n17.mask3.trial1",
"zephyr.pow2.v1.rvv.e8.m8.n17.mask3.trial2",
"zephyr.pow2.v1.rvv.e8.m8.n65.mask1.trial0",
"zephyr.pow2.v1.rvv.e8.m8.n65.mask1.trial1",
"zephyr.pow2.v1.rvv.e8.m8.n65.mask1.trial2",
"zephyr.pow2.v1.rvv.e8.m8.n65.mask2.trial0",
"zephyr.pow2.v1.rvv.e8.m8.n65.mask2.trial1",
"zephyr.pow2.v1.rvv.e8.m8.n65.mask2.trial2",
"zephyr.pow2.v1.rvv.e8.m8.n65.mask3.trial0",
"zephyr.pow2.v1.rvv.e8.m8.n65.mask3.trial1",
"zephyr.pow2.v1.rvv.e8.m8.n65.mask3.trial2",
"zephyr.pow2.v1.rvv.e16.m1.n17.mask1.trial0",
"zephyr.pow2.v1.rvv.e16.m1.n17.mask1.trial1",
"zephyr.pow2.v1.rvv.e16.m1.n17.mask1.trial2",
"zephyr.pow2.v1.rvv.e16.m1.n17.mask2.trial0",
"zephyr.pow2.v1.rvv.e16.m1.n17.mask2.trial1",
"zephyr.pow2.v1.rvv.e16.m1.n17.mask2.trial2",
"zephyr.pow2.v1.rvv.e16.m1.n17.mask3.trial0",
"zephyr.pow2.v1.rvv.e16.m1.n17.mask3.trial1",
"zephyr.pow2.v1.rvv.e16.m1.n17.mask3.trial2",
"zephyr.pow2.v1.rvv.e16.m1.n65.mask1.trial0",
"zephyr.pow2.v1.rvv.e16.m1.n65.mask1.trial1",
"zephyr.pow2.v1.rvv.e16.m1.n65.mask1.trial2",
"zephyr.pow2.v1.rvv.e16.m1.n65.mask2.trial0",
"zephyr.pow2.v1.rvv.e16.m1.n65.mask2.trial1",
"zephyr.pow2.v1.rvv.e16.m1.n65.mask2.trial2",
"zephyr.pow2.v1.rvv.e16.m1.n65.mask3.trial0",
"zephyr.pow2.v1.rvv.e16.m1.n65.mask3.trial1",
"zephyr.pow2.v1.rvv.e16.m1.n65.mask3.trial2",
"zephyr.pow2.v1.rvv.e16.m2.n17.mask1.trial0",
"zephyr.pow2.v1.rvv.e16.m2.n17.mask1.trial1",
"zephyr.pow2.v1.rvv.e16.m2.n17.mask1.trial2",
"zephyr.pow2.v1.rvv.e16.m2.n17.mask2.trial0",
"zephyr.pow2.v1.rvv.e16.m2.n17.mask2.trial1",
"zephyr.pow2.v1.rvv.e16.m2.n17.mask2.trial2",
"zephyr.pow2.v1.rvv.e16.m2.n17.mask3.trial0",
"zephyr.pow2.v1.rvv.e16.m2.n17.mask3.trial1",
"zephyr.pow2.v1.rvv.e16.m2.n17.mask3.trial2",
"zephyr.pow2.v1.rvv.e16.m2.n65.mask1.trial0",
"zephyr.pow2.v1.rvv.e16.m2.n65.mask1.trial1",
"zephyr.pow2.v1.rvv.e16.m2.n65.mask1.trial2",
"zephyr.pow2.v1.rvv.e16.m2.n65.mask2.trial0",
"zephyr.pow2.v1.rvv.e16.m2.n65.mask2.trial1",
"zephyr.pow2.v1.rvv.e16.m2.n65.mask2.trial2",
"zephyr.pow2.v1.rvv.e16.m2.n65.mask3.trial0",
"zephyr.pow2.v1.rvv.e16.m2.n65.mask3.trial1",
"zephyr.pow2.v1.rvv.e16.m2.n65.mask3.trial2",
"zephyr.pow2.v1.rvv.e16.m4.n17.mask1.trial0",
"zephyr.pow2.v1.rvv.e16.m4.n17.mask1.trial1",
"zephyr.pow2.v1.rvv.e16.m4.n17.mask1.trial2",
"zephyr.pow2.v1.rvv.e16.m4.n17.mask2.trial0",
"zephyr.pow2.v1.rvv.e16.m4.n17.mask2.trial1",
"zephyr.pow2.v1.rvv.e16.m4.n17.mask2.trial2",
"zephyr.pow2.v1.rvv.e16.m4.n17.mask3.trial0",
"zephyr.pow2.v1.rvv.e16.m4.n17.mask3.trial1",
"zephyr.pow2.v1.rvv.e16.m4.n17.mask3.trial2",
"zephyr.pow2.v1.rvv.e16.m4.n65.mask1.trial0",
"zephyr.pow2.v1.rvv.e16.m4.n65.mask1.trial1",
"zephyr.pow2.v1.rvv.e16.m4.n65.mask1.trial2",
"zephyr.pow2.v1.rvv.e16.m4.n65.mask2.trial0",
"zephyr.pow2.v1.rvv.e16.m4.n65.mask2.trial1",
"zephyr.pow2.v1.rvv.e16.m4.n65.mask2.trial2",
"zephyr.pow2.v1.rvv.e16.m4.n65.mask3.trial0",
"zephyr.pow2.v1.rvv.e16.m4.n65.mask3.trial1",
"zephyr.pow2.v1.rvv.e16.m4.n65.mask3.trial2",
"zephyr.pow2.v1.rvv.e16.m8.n17.mask1.trial0",
"zephyr.pow2.v1.rvv.e16.m8.n17.mask1.trial1",
"zephyr.pow2.v1.rvv.e16.m8.n17.mask1.trial2",
"zephyr.pow2.v1.rvv.e16.m8.n17.mask2.trial0",
"zephyr.pow2.v1.rvv.e16.m8.n17.mask2.trial1",
"zephyr.pow2.v1.rvv.e16.m8.n17.mask2.trial2",
"zephyr.pow2.v1.rvv.e16.m8.n17.mask3.trial0",
"zephyr.pow2.v1.rvv.e16.m8.n17.mask3.trial1",
"zephyr.pow2.v1.rvv.e16.m8.n17.mask3.trial2",
"zephyr.pow2.v1.rvv.e16.m8.n65.mask1.trial0",
"zephyr.pow2.v1.rvv.e16.m8.n65.mask1.trial1",
"zephyr.pow2.v1.rvv.e16.m8.n65.mask1.trial2",
"zephyr.pow2.v1.rvv.e16.m8.n65.mask2.trial0",
"zephyr.pow2.v1.rvv.e16.m8.n65.mask2.trial1",
"zephyr.pow2.v1.rvv.e16.m8.n65.mask2.trial2",
"zephyr.pow2.v1.rvv.e16.m8.n65.mask3.trial0",
"zephyr.pow2.v1.rvv.e16.m8.n65.mask3.trial1",
"zephyr.pow2.v1.rvv.e16.m8.n65.mask3.trial2",
"zephyr.pow2.v1.rvv.e32.m1.n17.mask1.trial0",
"zephyr.pow2.v1.rvv.e32.m1.n17.mask1.trial1",
"zephyr.pow2.v1.rvv.e32.m1.n17.mask1.trial2",
"zephyr.pow2.v1.rvv.e32.m1.n17.mask2.trial0",
"zephyr.pow2.v1.rvv.e32.m1.n17.mask2.trial1",
"zephyr.pow2.v1.rvv.e32.m1.n17.mask2.trial2",
"zephyr.pow2.v1.rvv.e32.m1.n17.mask3.trial0",
"zephyr.pow2.v1.rvv.e32.m1.n17.mask3.trial1",
"zephyr.pow2.v1.rvv.e32.m1.n17.mask3.trial2",
"zephyr.pow2.v1.rvv.e32.m1.n65.mask1.trial0",
"zephyr.pow2.v1.rvv.e32.m1.n65.mask1.trial1",
"zephyr.pow2.v1.rvv.e32.m1.n65.mask1.trial2",
"zephyr.pow2.v1.rvv.e32.m1.n65.mask2.trial0",
"zephyr.pow2.v1.rvv.e32.m1.n65.mask2.trial1",
"zephyr.pow2.v1.rvv.e32.m1.n65.mask2.trial2",
"zephyr.pow2.v1.rvv.e32.m1.n65.mask3.trial0",
"zephyr.pow2.v1.rvv.e32.m1.n65.mask3.trial1",
"zephyr.pow2.v1.rvv.e32.m1.n65.mask3.trial2",
"zephyr.pow2.v1.rvv.e32.m2.n17.mask1.trial0",
"zephyr.pow2.v1.rvv.e32.m2.n17.mask1.trial1",
"zephyr.pow2.v1.rvv.e32.m2.n17.mask1.trial2",
"zephyr.pow2.v1.rvv.e32.m2.n17.mask2.trial0",
"zephyr.pow2.v1.rvv.e32.m2.n17.mask2.trial1",
"zephyr.pow2.v1.rvv.e32.m2.n17.mask2.trial2",
"zephyr.pow2.v1.rvv.e32.m2.n17.mask3.trial0",
"zephyr.pow2.v1.rvv.e32.m2.n17.mask3.trial1",
"zephyr.pow2.v1.rvv.e32.m2.n17.mask3.trial2",
"zephyr.pow2.v1.rvv.e32.m2.n65.mask1.trial0",
"zephyr.pow2.v1.rvv.e32.m2.n65.mask1.trial1",
"zephyr.pow2.v1.rvv.e32.m2.n65.mask1.trial2",
"zephyr.pow2.v1.rvv.e32.m2.n65.mask2.trial0",
"zephyr.pow2.v1.rvv.e32.m2.n65.mask2.trial1",
"zephyr.pow2.v1.rvv.e32.m2.n65.mask2.trial2",
"zephyr.pow2.v1.rvv.e32.m2.n65.mask3.trial0",
"zephyr.pow2.v1.rvv.e32.m2.n65.mask3.trial1",
"zephyr.pow2.v1.rvv.e32.m2.n65.mask3.trial2",
"zephyr.pow2.v1.rvv.e32.m4.n17.mask1.trial0",
"zephyr.pow2.v1.rvv.e32.m4.n17.mask1.trial1",
"zephyr.pow2.v1.rvv.e32.m4.n17.mask1.trial2",
"zephyr.pow2.v1.rvv.e32.m4.n17.mask2.trial0",
"zephyr.pow2.v1.rvv.e32.m4.n17.mask2.trial1",
"zephyr.pow2.v1.rvv.e32.m4.n17.mask2.trial2",
"zephyr.pow2.v1.rvv.e32.m4.n17.mask3.trial0",
"zephyr.pow2.v1.rvv.e32.m4.n17.mask3.trial1",
"zephyr.pow2.v1.rvv.e32.m4.n17.mask3.trial2",
"zephyr.pow2.v1.rvv.e32.m4.n65.mask1.trial0",
"zephyr.pow2.v1.rvv.e32.m4.n65.mask1.trial1",
"zephyr.pow2.v1.rvv.e32.m4.n65.mask1.trial2",
"zephyr.pow2.v1.rvv.e32.m4.n65.mask2.trial0",
"zephyr.pow2.v1.rvv.e32.m4.n65.mask2.trial1",
"zephyr.pow2.v1.rvv.e32.m4.n65.mask2.trial2",
"zephyr.pow2.v1.rvv.e32.m4.n65.mask3.trial0",
"zephyr.pow2.v1.rvv.e32.m4.n65.mask3.trial1",
"zephyr.pow2.v1.rvv.e32.m4.n65.mask3.trial2",
"zephyr.pow2.v1.rvv.e32.m8.n17.mask1.trial0",
"zephyr.pow2.v1.rvv.e32.m8.n17.mask1.trial1",
"zephyr.pow2.v1.rvv.e32.m8.n17.mask1.trial2",
"zephyr.pow2.v1.rvv.e32.m8.n17.mask2.trial0",
"zephyr.pow2.v1.rvv.e32.m8.n17.mask2.trial1",
"zephyr.pow2.v1.rvv.e32.m8.n17.mask2.trial2",
"zephyr.pow2.v1.rvv.e32.m8.n17.mask3.trial0",
"zephyr.pow2.v1.rvv.e32.m8.n17.mask3.trial1",
"zephyr.pow2.v1.rvv.e32.m8.n17.mask3.trial2",
"zephyr.pow2.v1.rvv.e32.m8.n65.mask1.trial0",
"zephyr.pow2.v1.rvv.e32.m8.n65.mask1.trial1",
"zephyr.pow2.v1.rvv.e32.m8.n65.mask1.trial2",
"zephyr.pow2.v1.rvv.e32.m8.n65.mask2.trial0",
"zephyr.pow2.v1.rvv.e32.m8.n65.mask2.trial1",
"zephyr.pow2.v1.rvv.e32.m8.n65.mask2.trial2",
"zephyr.pow2.v1.rvv.e32.m8.n65.mask3.trial0",
"zephyr.pow2.v1.rvv.e32.m8.n65.mask3.trial1",
"zephyr.pow2.v1.rvv.e32.m8.n65.mask3.trial2",
"zephyr.pow2.v1.vme.int8.u_u.m8.n17.mask1.trial0",
"zephyr.pow2.v1.vme.int8.u_u.m8.n17.mask1.trial1",
"zephyr.pow2.v1.vme.int8.u_u.m8.n17.mask1.trial2",
"zephyr.pow2.v1.vme.int8.u_u.m8.n17.mask2.trial0",
"zephyr.pow2.v1.vme.int8.u_u.m8.n17.mask2.trial1",
"zephyr.pow2.v1.vme.int8.u_u.m8.n17.mask2.trial2",
"zephyr.pow2.v1.vme.int8.u_u.m8.n17.mask3.trial0",
"zephyr.pow2.v1.vme.int8.u_u.m8.n17.mask3.trial1",
"zephyr.pow2.v1.vme.int8.u_u.m8.n17.mask3.trial2",
"zephyr.pow2.v1.vme.int8.u_u.m8.n65.mask1.trial0",
"zephyr.pow2.v1.vme.int8.u_u.m8.n65.mask1.trial1",
"zephyr.pow2.v1.vme.int8.u_u.m8.n65.mask1.trial2",
"zephyr.pow2.v1.vme.int8.u_u.m8.n65.mask2.trial0",
"zephyr.pow2.v1.vme.int8.u_u.m8.n65.mask2.trial1",
"zephyr.pow2.v1.vme.int8.u_u.m8.n65.mask2.trial2",
"zephyr.pow2.v1.vme.int8.u_u.m8.n65.mask3.trial0",
"zephyr.pow2.v1.vme.int8.u_u.m8.n65.mask3.trial1",
"zephyr.pow2.v1.vme.int8.u_u.m8.n65.mask3.trial2",
"zephyr.pow2.v1.vme.fp8.e4m3_e4m3.m8.n17.mask1.trial0",
"zephyr.pow2.v1.vme.fp8.e4m3_e4m3.m8.n17.mask1.trial1",
"zephyr.pow2.v1.vme.fp8.e4m3_e4m3.m8.n17.mask1.trial2",
"zephyr.pow2.v1.vme.fp8.e4m3_e4m3.m8.n17.mask2.trial0",
"zephyr.pow2.v1.vme.fp8.e4m3_e4m3.m8.n17.mask2.trial1",
"zephyr.pow2.v1.vme.fp8.e4m3_e4m3.m8.n17.mask2.trial2",
"zephyr.pow2.v1.vme.fp8.e4m3_e4m3.m8.n17.mask3.trial0",
"zephyr.pow2.v1.vme.fp8.e4m3_e4m3.m8.n17.mask3.trial1",
"zephyr.pow2.v1.vme.fp8.e4m3_e4m3.m8.n17.mask3.trial2",
"zephyr.pow2.v1.vme.fp8.e4m3_e4m3.m8.n65.mask1.trial0",
"zephyr.pow2.v1.vme.fp8.e4m3_e4m3.m8.n65.mask1.trial1",
"zephyr.pow2.v1.vme.fp8.e4m3_e4m3.m8.n65.mask1.trial2",
"zephyr.pow2.v1.vme.fp8.e4m3_e4m3.m8.n65.mask2.trial0",
"zephyr.pow2.v1.vme.fp8.e4m3_e4m3.m8.n65.mask2.trial1",
"zephyr.pow2.v1.vme.fp8.e4m3_e4m3.m8.n65.mask2.trial2",
"zephyr.pow2.v1.vme.fp8.e4m3_e4m3.m8.n65.mask3.trial0",
"zephyr.pow2.v1.vme.fp8.e4m3_e4m3.m8.n65.mask3.trial1",
"zephyr.pow2.v1.vme.fp8.e4m3_e4m3.m8.n65.mask3.trial2",
"zephyr.pow2.v1.vme.fp8.e4m3_e5m2.m8.n17.mask1.trial0",
"zephyr.pow2.v1.vme.fp8.e4m3_e5m2.m8.n17.mask1.trial1",
"zephyr.pow2.v1.vme.fp8.e4m3_e5m2.m8.n17.mask1.trial2",
"zephyr.pow2.v1.vme.fp8.e4m3_e5m2.m8.n17.mask2.trial0",
"zephyr.pow2.v1.vme.fp8.e4m3_e5m2.m8.n17.mask2.trial1",
"zephyr.pow2.v1.vme.fp8.e4m3_e5m2.m8.n17.mask2.trial2",
"zephyr.pow2.v1.vme.fp8.e4m3_e5m2.m8.n17.mask3.trial0",
"zephyr.pow2.v1.vme.fp8.e4m3_e5m2.m8.n17.mask3.trial1",
"zephyr.pow2.v1.vme.fp8.e4m3_e5m2.m8.n17.mask3.trial2",
"zephyr.pow2.v1.vme.fp8.e4m3_e5m2.m8.n65.mask1.trial0",
"zephyr.pow2.v1.vme.fp8.e4m3_e5m2.m8.n65.mask1.trial1",
"zephyr.pow2.v1.vme.fp8.e4m3_e5m2.m8.n65.mask1.trial2",
"zephyr.pow2.v1.vme.fp8.e4m3_e5m2.m8.n65.mask2.trial0",
"zephyr.pow2.v1.vme.fp8.e4m3_e5m2.m8.n65.mask2.trial1",
"zephyr.pow2.v1.vme.fp8.e4m3_e5m2.m8.n65.mask2.trial2",
"zephyr.pow2.v1.vme.fp8.e4m3_e5m2.m8.n65.mask3.trial0",
"zephyr.pow2.v1.vme.fp8.e4m3_e5m2.m8.n65.mask3.trial1",
"zephyr.pow2.v1.vme.fp8.e4m3_e5m2.m8.n65.mask3.trial2",
"zephyr.pow2.v1.vme.fp8.e5m2_e4m3.m8.n17.mask1.trial0",
"zephyr.pow2.v1.vme.fp8.e5m2_e4m3.m8.n17.mask1.trial1",
"zephyr.pow2.v1.vme.fp8.e5m2_e4m3.m8.n17.mask1.trial2",
"zephyr.pow2.v1.vme.fp8.e5m2_e4m3.m8.n17.mask2.trial0",
"zephyr.pow2.v1.vme.fp8.e5m2_e4m3.m8.n17.mask2.trial1",
"zephyr.pow2.v1.vme.fp8.e5m2_e4m3.m8.n17.mask2.trial2",
"zephyr.pow2.v1.vme.fp8.e5m2_e4m3.m8.n17.mask3.trial0",
"zephyr.pow2.v1.vme.fp8.e5m2_e4m3.m8.n17.mask3.trial1",
"zephyr.pow2.v1.vme.fp8.e5m2_e4m3.m8.n17.mask3.trial2",
"zephyr.pow2.v1.vme.fp8.e5m2_e4m3.m8.n65.mask1.trial0",
"zephyr.pow2.v1.vme.fp8.e5m2_e4m3.m8.n65.mask1.trial1",
"zephyr.pow2.v1.vme.fp8.e5m2_e4m3.m8.n65.mask1.trial2",
"zephyr.pow2.v1.vme.fp8.e5m2_e4m3.m8.n65.mask2.trial0",
"zephyr.pow2.v1.vme.fp8.e5m2_e4m3.m8.n65.mask2.trial1",
"zephyr.pow2.v1.vme.fp8.e5m2_e4m3.m8.n65.mask2.trial2",
"zephyr.pow2.v1.vme.fp8.e5m2_e4m3.m8.n65.mask3.trial0",
"zephyr.pow2.v1.vme.fp8.e5m2_e4m3.m8.n65.mask3.trial1",
"zephyr.pow2.v1.vme.fp8.e5m2_e4m3.m8.n65.mask3.trial2",
"zephyr.pow2.v1.vme.fp8.e5m2_e5m2.m8.n17.mask1.trial0",
"zephyr.pow2.v1.vme.fp8.e5m2_e5m2.m8.n17.mask1.trial1",
"zephyr.pow2.v1.vme.fp8.e5m2_e5m2.m8.n17.mask1.trial2",
"zephyr.pow2.v1.vme.fp8.e5m2_e5m2.m8.n17.mask2.trial0",
"zephyr.pow2.v1.vme.fp8.e5m2_e5m2.m8.n17.mask2.trial1",
"zephyr.pow2.v1.vme.fp8.e5m2_e5m2.m8.n17.mask2.trial2",
"zephyr.pow2.v1.vme.fp8.e5m2_e5m2.m8.n17.mask3.trial0",
"zephyr.pow2.v1.vme.fp8.e5m2_e5m2.m8.n17.mask3.trial1",
"zephyr.pow2.v1.vme.fp8.e5m2_e5m2.m8.n17.mask3.trial2",
"zephyr.pow2.v1.vme.fp8.e5m2_e5m2.m8.n65.mask1.trial0",
"zephyr.pow2.v1.vme.fp8.e5m2_e5m2.m8.n65.mask1.trial1",
"zephyr.pow2.v1.vme.fp8.e5m2_e5m2.m8.n65.mask1.trial2",
"zephyr.pow2.v1.vme.fp8.e5m2_e5m2.m8.n65.mask2.trial0",
"zephyr.pow2.v1.vme.fp8.e5m2_e5m2.m8.n65.mask2.trial1",
"zephyr.pow2.v1.vme.fp8.e5m2_e5m2.m8.n65.mask2.trial2",
"zephyr.pow2.v1.vme.fp8.e5m2_e5m2.m8.n65.mask3.trial0",
"zephyr.pow2.v1.vme.fp8.e5m2_e5m2.m8.n65.mask3.trial1",
"zephyr.pow2.v1.vme.fp8.e5m2_e5m2.m8.n65.mask3.trial2",
"zephyr.pow2.v1.vme.int8.u_u.m16.n17.mask1.trial0",
"zephyr.pow2.v1.vme.int8.u_u.m16.n17.mask1.trial1",
"zephyr.pow2.v1.vme.int8.u_u.m16.n17.mask1.trial2",
"zephyr.pow2.v1.vme.int8.u_u.m16.n17.mask2.trial0",
"zephyr.pow2.v1.vme.int8.u_u.m16.n17.mask2.trial1",
"zephyr.pow2.v1.vme.int8.u_u.m16.n17.mask2.trial2",
"zephyr.pow2.v1.vme.int8.u_u.m16.n17.mask3.trial0",
"zephyr.pow2.v1.vme.int8.u_u.m16.n17.mask3.trial1",
"zephyr.pow2.v1.vme.int8.u_u.m16.n17.mask3.trial2",
"zephyr.pow2.v1.vme.int8.u_u.m16.n65.mask1.trial0",
"zephyr.pow2.v1.vme.int8.u_u.m16.n65.mask1.trial1",
"zephyr.pow2.v1.vme.int8.u_u.m16.n65.mask1.trial2",
"zephyr.pow2.v1.vme.int8.u_u.m16.n65.mask2.trial0",
"zephyr.pow2.v1.vme.int8.u_u.m16.n65.mask2.trial1",
"zephyr.pow2.v1.vme.int8.u_u.m16.n65.mask2.trial2",
"zephyr.pow2.v1.vme.int8.u_u.m16.n65.mask3.trial0",
"zephyr.pow2.v1.vme.int8.u_u.m16.n65.mask3.trial1",
"zephyr.pow2.v1.vme.int8.u_u.m16.n65.mask3.trial2",
"zephyr.pow2.v1.vme.fp8.e4m3_e4m3.m16.n17.mask1.trial0",
"zephyr.pow2.v1.vme.fp8.e4m3_e4m3.m16.n17.mask1.trial1",
"zephyr.pow2.v1.vme.fp8.e4m3_e4m3.m16.n17.mask1.trial2",
"zephyr.pow2.v1.vme.fp8.e4m3_e4m3.m16.n17.mask2.trial0",
"zephyr.pow2.v1.vme.fp8.e4m3_e4m3.m16.n17.mask2.trial1",
"zephyr.pow2.v1.vme.fp8.e4m3_e4m3.m16.n17.mask2.trial2",
"zephyr.pow2.v1.vme.fp8.e4m3_e4m3.m16.n17.mask3.trial0",
"zephyr.pow2.v1.vme.fp8.e4m3_e4m3.m16.n17.mask3.trial1",
"zephyr.pow2.v1.vme.fp8.e4m3_e4m3.m16.n17.mask3.trial2",
"zephyr.pow2.v1.vme.fp8.e4m3_e4m3.m16.n65.mask1.trial0",
"zephyr.pow2.v1.vme.fp8.e4m3_e4m3.m16.n65.mask1.trial1",
"zephyr.pow2.v1.vme.fp8.e4m3_e4m3.m16.n65.mask1.trial2",
"zephyr.pow2.v1.vme.fp8.e4m3_e4m3.m16.n65.mask2.trial0",
"zephyr.pow2.v1.vme.fp8.e4m3_e4m3.m16.n65.mask2.trial1",
"zephyr.pow2.v1.vme.fp8.e4m3_e4m3.m16.n65.mask2.trial2",
"zephyr.pow2.v1.vme.fp8.e4m3_e4m3.m16.n65.mask3.trial0",
"zephyr.pow2.v1.vme.fp8.e4m3_e4m3.m16.n65.mask3.trial1",
"zephyr.pow2.v1.vme.fp8.e4m3_e4m3.m16.n65.mask3.trial2",
"zephyr.pow2.v1.vme.fp8.e4m3_e5m2.m16.n17.mask1.trial0",
"zephyr.pow2.v1.vme.fp8.e4m3_e5m2.m16.n17.mask1.trial1",
"zephyr.pow2.v1.vme.fp8.e4m3_e5m2.m16.n17.mask1.trial2",
"zephyr.pow2.v1.vme.fp8.e4m3_e5m2.m16.n17.mask2.trial0",
"zephyr.pow2.v1.vme.fp8.e4m3_e5m2.m16.n17.mask2.trial1",
"zephyr.pow2.v1.vme.fp8.e4m3_e5m2.m16.n17.mask2.trial2",
"zephyr.pow2.v1.vme.fp8.e4m3_e5m2.m16.n17.mask3.trial0",
"zephyr.pow2.v1.vme.fp8.e4m3_e5m2.m16.n17.mask3.trial1",
"zephyr.pow2.v1.vme.fp8.e4m3_e5m2.m16.n17.mask3.trial2",
"zephyr.pow2.v1.vme.fp8.e4m3_e5m2.m16.n65.mask1.trial0",
"zephyr.pow2.v1.vme.fp8.e4m3_e5m2.m16.n65.mask1.trial1",
"zephyr.pow2.v1.vme.fp8.e4m3_e5m2.m16.n65.mask1.trial2",
"zephyr.pow2.v1.vme.fp8.e4m3_e5m2.m16.n65.mask2.trial0",
"zephyr.pow2.v1.vme.fp8.e4m3_e5m2.m16.n65.mask2.trial1",
"zephyr.pow2.v1.vme.fp8.e4m3_e5m2.m16.n65.mask2.trial2",
"zephyr.pow2.v1.vme.fp8.e4m3_e5m2.m16.n65.mask3.trial0",
"zephyr.pow2.v1.vme.fp8.e4m3_e5m2.m16.n65.mask3.trial1",
"zephyr.pow2.v1.vme.fp8.e4m3_e5m2.m16.n65.mask3.trial2",
"zephyr.pow2.v1.vme.fp8.e5m2_e4m3.m16.n17.mask1.trial0",
"zephyr.pow2.v1.vme.fp8.e5m2_e4m3.m16.n17.mask1.trial1",
"zephyr.pow2.v1.vme.fp8.e5m2_e4m3.m16.n17.mask1.trial2",
"zephyr.pow2.v1.vme.fp8.e5m2_e4m3.m16.n17.mask2.trial0",
"zephyr.pow2.v1.vme.fp8.e5m2_e4m3.m16.n17.mask2.trial1",
"zephyr.pow2.v1.vme.fp8.e5m2_e4m3.m16.n17.mask2.trial2",
"zephyr.pow2.v1.vme.fp8.e5m2_e4m3.m16.n17.mask3.trial0",
"zephyr.pow2.v1.vme.fp8.e5m2_e4m3.m16.n17.mask3.trial1",
"zephyr.pow2.v1.vme.fp8.e5m2_e4m3.m16.n17.mask3.trial2",
"zephyr.pow2.v1.vme.fp8.e5m2_e4m3.m16.n65.mask1.trial0",
"zephyr.pow2.v1.vme.fp8.e5m2_e4m3.m16.n65.mask1.trial1",
"zephyr.pow2.v1.vme.fp8.e5m2_e4m3.m16.n65.mask1.trial2",
"zephyr.pow2.v1.vme.fp8.e5m2_e4m3.m16.n65.mask2.trial0",
"zephyr.pow2.v1.vme.fp8.e5m2_e4m3.m16.n65.mask2.trial1",
"zephyr.pow2.v1.vme.fp8.e5m2_e4m3.m16.n65.mask2.trial2",
"zephyr.pow2.v1.vme.fp8.e5m2_e4m3.m16.n65.mask3.trial0",
"zephyr.pow2.v1.vme.fp8.e5m2_e4m3.m16.n65.mask3.trial1",
"zephyr.pow2.v1.vme.fp8.e5m2_e4m3.m16.n65.mask3.trial2",
"zephyr.pow2.v1.vme.fp8.e5m2_e5m2.m16.n17.mask1.trial0",
"zephyr.pow2.v1.vme.fp8.e5m2_e5m2.m16.n17.mask1.trial1",
"zephyr.pow2.v1.vme.fp8.e5m2_e5m2.m16.n17.mask1.trial2",
"zephyr.pow2.v1.vme.fp8.e5m2_e5m2.m16.n17.mask2.trial0",
"zephyr.pow2.v1.vme.fp8.e5m2_e5m2.m16.n17.mask2.trial1",
"zephyr.pow2.v1.vme.fp8.e5m2_e5m2.m16.n17.mask2.trial2",
"zephyr.pow2.v1.vme.fp8.e5m2_e5m2.m16.n17.mask3.trial0",
"zephyr.pow2.v1.vme.fp8.e5m2_e5m2.m16.n17.mask3.trial1",
"zephyr.pow2.v1.vme.fp8.e5m2_e5m2.m16.n17.mask3.trial2",
"zephyr.pow2.v1.vme.fp8.e5m2_e5m2.m16.n65.mask1.trial0",
"zephyr.pow2.v1.vme.fp8.e5m2_e5m2.m16.n65.mask1.trial1",
"zephyr.pow2.v1.vme.fp8.e5m2_e5m2.m16.n65.mask1.trial2",
"zephyr.pow2.v1.vme.fp8.e5m2_e5m2.m16.n65.mask2.trial0",
"zephyr.pow2.v1.vme.fp8.e5m2_e5m2.m16.n65.mask2.trial1",
"zephyr.pow2.v1.vme.fp8.e5m2_e5m2.m16.n65.mask2.trial2",
"zephyr.pow2.v1.vme.fp8.e5m2_e5m2.m16.n65.mask3.trial0",
"zephyr.pow2.v1.vme.fp8.e5m2_e5m2.m16.n65.mask3.trial1",
"zephyr.pow2.v1.vme.fp8.e5m2_e5m2.m16.n65.mask3.trial2",
"zephyr.pow2.v1.vme.int8.u_u.m32.n17.mask1.trial0",
"zephyr.pow2.v1.vme.int8.u_u.m32.n17.mask1.trial1",
"zephyr.pow2.v1.vme.int8.u_u.m32.n17.mask1.trial2",
"zephyr.pow2.v1.vme.int8.u_u.m32.n17.mask2.trial0",
"zephyr.pow2.v1.vme.int8.u_u.m32.n17.mask2.trial1",
"zephyr.pow2.v1.vme.int8.u_u.m32.n17.mask2.trial2",
"zephyr.pow2.v1.vme.int8.u_u.m32.n17.mask3.trial0",
"zephyr.pow2.v1.vme.int8.u_u.m32.n17.mask3.trial1",
"zephyr.pow2.v1.vme.int8.u_u.m32.n17.mask3.trial2",
"zephyr.pow2.v1.vme.int8.u_u.m32.n65.mask1.trial0",
"zephyr.pow2.v1.vme.int8.u_u.m32.n65.mask1.trial1",
"zephyr.pow2.v1.vme.int8.u_u.m32.n65.mask1.trial2",
"zephyr.pow2.v1.vme.int8.u_u.m32.n65.mask2.trial0",
"zephyr.pow2.v1.vme.int8.u_u.m32.n65.mask2.trial1",
"zephyr.pow2.v1.vme.int8.u_u.m32.n65.mask2.trial2",
"zephyr.pow2.v1.vme.int8.u_u.m32.n65.mask3.trial0",
"zephyr.pow2.v1.vme.int8.u_u.m32.n65.mask3.trial1",
"zephyr.pow2.v1.vme.int8.u_u.m32.n65.mask3.trial2",
"zephyr.pow2.v1.vme.fp8.e4m3_e4m3.m32.n17.mask1.trial0",
"zephyr.pow2.v1.vme.fp8.e4m3_e4m3.m32.n17.mask1.trial1",
"zephyr.pow2.v1.vme.fp8.e4m3_e4m3.m32.n17.mask1.trial2",
"zephyr.pow2.v1.vme.fp8.e4m3_e4m3.m32.n17.mask2.trial0",
"zephyr.pow2.v1.vme.fp8.e4m3_e4m3.m32.n17.mask2.trial1",
"zephyr.pow2.v1.vme.fp8.e4m3_e4m3.m32.n17.mask2.trial2",
"zephyr.pow2.v1.vme.fp8.e4m3_e4m3.m32.n17.mask3.trial0",
"zephyr.pow2.v1.vme.fp8.e4m3_e4m3.m32.n17.mask3.trial1",
"zephyr.pow2.v1.vme.fp8.e4m3_e4m3.m32.n17.mask3.trial2",
"zephyr.pow2.v1.vme.fp8.e4m3_e4m3.m32.n65.mask1.trial0",
"zephyr.pow2.v1.vme.fp8.e4m3_e4m3.m32.n65.mask1.trial1",
"zephyr.pow2.v1.vme.fp8.e4m3_e4m3.m32.n65.mask1.trial2",
"zephyr.pow2.v1.vme.fp8.e4m3_e4m3.m32.n65.mask2.trial0",
"zephyr.pow2.v1.vme.fp8.e4m3_e4m3.m32.n65.mask2.trial1",
"zephyr.pow2.v1.vme.fp8.e4m3_e4m3.m32.n65.mask2.trial2",
"zephyr.pow2.v1.vme.fp8.e4m3_e4m3.m32.n65.mask3.trial0",
"zephyr.pow2.v1.vme.fp8.e4m3_e4m3.m32.n65.mask3.trial1",
"zephyr.pow2.v1.vme.fp8.e4m3_e4m3.m32.n65.mask3.trial2",
"zephyr.pow2.v1.vme.fp8.e4m3_e5m2.m32.n17.mask1.trial0",
"zephyr.pow2.v1.vme.fp8.e4m3_e5m2.m32.n17.mask1.trial1",
"zephyr.pow2.v1.vme.fp8.e4m3_e5m2.m32.n17.mask1.trial2",
"zephyr.pow2.v1.vme.fp8.e4m3_e5m2.m32.n17.mask2.trial0",
"zephyr.pow2.v1.vme.fp8.e4m3_e5m2.m32.n17.mask2.trial1",
"zephyr.pow2.v1.vme.fp8.e4m3_e5m2.m32.n17.mask2.trial2",
"zephyr.pow2.v1.vme.fp8.e4m3_e5m2.m32.n17.mask3.trial0",
"zephyr.pow2.v1.vme.fp8.e4m3_e5m2.m32.n17.mask3.trial1",
"zephyr.pow2.v1.vme.fp8.e4m3_e5m2.m32.n17.mask3.trial2",
"zephyr.pow2.v1.vme.fp8.e4m3_e5m2.m32.n65.mask1.trial0",
"zephyr.pow2.v1.vme.fp8.e4m3_e5m2.m32.n65.mask1.trial1",
"zephyr.pow2.v1.vme.fp8.e4m3_e5m2.m32.n65.mask1.trial2",
"zephyr.pow2.v1.vme.fp8.e4m3_e5m2.m32.n65.mask2.trial0",
"zephyr.pow2.v1.vme.fp8.e4m3_e5m2.m32.n65.mask2.trial1",
"zephyr.pow2.v1.vme.fp8.e4m3_e5m2.m32.n65.mask2.trial2",
"zephyr.pow2.v1.vme.fp8.e4m3_e5m2.m32.n65.mask3.trial0",
"zephyr.pow2.v1.vme.fp8.e4m3_e5m2.m32.n65.mask3.trial1",
"zephyr.pow2.v1.vme.fp8.e4m3_e5m2.m32.n65.mask3.trial2",
"zephyr.pow2.v1.vme.fp8.e5m2_e4m3.m32.n17.mask1.trial0",
"zephyr.pow2.v1.vme.fp8.e5m2_e4m3.m32.n17.mask1.trial1",
"zephyr.pow2.v1.vme.fp8.e5m2_e4m3.m32.n17.mask1.trial2",
"zephyr.pow2.v1.vme.fp8.e5m2_e4m3.m32.n17.mask2.trial0",
"zephyr.pow2.v1.vme.fp8.e5m2_e4m3.m32.n17.mask2.trial1",
"zephyr.pow2.v1.vme.fp8.e5m2_e4m3.m32.n17.mask2.trial2",
"zephyr.pow2.v1.vme.fp8.e5m2_e4m3.m32.n17.mask3.trial0",
"zephyr.pow2.v1.vme.fp8.e5m2_e4m3.m32.n17.mask3.trial1",
"zephyr.pow2.v1.vme.fp8.e5m2_e4m3.m32.n17.mask3.trial2",
"zephyr.pow2.v1.vme.fp8.e5m2_e4m3.m32.n65.mask1.trial0",
"zephyr.pow2.v1.vme.fp8.e5m2_e4m3.m32.n65.mask1.trial1",
"zephyr.pow2.v1.vme.fp8.e5m2_e4m3.m32.n65.mask1.trial2",
"zephyr.pow2.v1.vme.fp8.e5m2_e4m3.m32.n65.mask2.trial0",
"zephyr.pow2.v1.vme.fp8.e5m2_e4m3.m32.n65.mask2.trial1",
"zephyr.pow2.v1.vme.fp8.e5m2_e4m3.m32.n65.mask2.trial2",
"zephyr.pow2.v1.vme.fp8.e5m2_e4m3.m32.n65.mask3.trial0",
"zephyr.pow2.v1.vme.fp8.e5m2_e4m3.m32.n65.mask3.trial1",
"zephyr.pow2.v1.vme.fp8.e5m2_e4m3.m32.n65.mask3.trial2",
"zephyr.pow2.v1.vme.fp8.e5m2_e5m2.m32.n17.mask1.trial0",
"zephyr.pow2.v1.vme.fp8.e5m2_e5m2.m32.n17.mask1.trial1",
"zephyr.pow2.v1.vme.fp8.e5m2_e5m2.m32.n17.mask1.trial2",
"zephyr.pow2.v1.vme.fp8.e5m2_e5m2.m32.n17.mask2.trial0",
"zephyr.pow2.v1.vme.fp8.e5m2_e5m2.m32.n17.mask2.trial1",
"zephyr.pow2.v1.vme.fp8.e5m2_e5m2.m32.n17.mask2.trial2",
"zephyr.pow2.v1.vme.fp8.e5m2_e5m2.m32.n17.mask3.trial0",
"zephyr.pow2.v1.vme.fp8.e5m2_e5m2.m32.n17.mask3.trial1",
"zephyr.pow2.v1.vme.fp8.e5m2_e5m2.m32.n17.mask3.trial2",
"zephyr.pow2.v1.vme.fp8.e5m2_e5m2.m32.n65.mask1.trial0",
"zephyr.pow2.v1.vme.fp8.e5m2_e5m2.m32.n65.mask1.trial1",
"zephyr.pow2.v1.vme.fp8.e5m2_e5m2.m32.n65.mask1.trial2",
"zephyr.pow2.v1.vme.fp8.e5m2_e5m2.m32.n65.mask2.trial0",
"zephyr.pow2.v1.vme.fp8.e5m2_e5m2.m32.n65.mask2.trial1",
"zephyr.pow2.v1.vme.fp8.e5m2_e5m2.m32.n65.mask2.trial2",
"zephyr.pow2.v1.vme.fp8.e5m2_e5m2.m32.n65.mask3.trial0",
"zephyr.pow2.v1.vme.fp8.e5m2_e5m2.m32.n65.mask3.trial1",
"zephyr.pow2.v1.vme.fp8.e5m2_e5m2.m32.n65.mask3.trial2",
};
