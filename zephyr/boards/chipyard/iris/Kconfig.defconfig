## zephyr/boards/chipyard/iris/Kconfig.defconfig
```kconfig
if BOARD_IRIS

config SYS_CLOCK_HW_CYCLES_PER_SEC
	default 500000

config RTC_CLOCK_DIVIDER_VALUE
	default 1000

config MP_MAX_NUM_CPUS
	default 3

config NUM_IRQS
	default 14

config MAX_IRQ_PER_AGGREGATOR
	default 2

endif
```

## zephyr/boards/chipyard/iris/board.yml
```yaml
board:
  name: iris
  full_name: Iris heterogeneous three-hart SoC
  vendor: chipyard
  socs:
    - name: rocketchip_virt_riscv64
```

## zephyr/boards/chipyard/iris/iris_defconfig
```kconfig
CONFIG_SMP=y
CONFIG_MP_MAX_NUM_CPUS=3
CONFIG_RISCV_PMP=n
CONFIG_FPU=y
CONFIG_FPU_SHARING=y
CONFIG_FLOAT_HARD=y
CONFIG_CONSOLE=y
CONFIG_UART_CONSOLE=y
CONFIG_SERIAL=y
CONFIG_UART_SIFIVE=y
CONFIG_UART_SIFIVE_PORT_0=y
CONFIG_UART_INTERRUPT_DRIVEN=n
CONFIG_UART_HTIF=y
CONFIG_PRINTK=y
CONFIG_REBOOT=y
CONFIG_XIP=n
CONFIG_MINIMAL_LIBC=y
CONFIG_SYS_CLOCK_HW_CYCLES_PER_SEC=500000
CONFIG_SYS_CLOCK_TICKS_PER_SEC=1000
CONFIG_SPEED_OPTIMIZATIONS=y
CONFIG_IDLE_STACK_SIZE=2048
```

## zephyr/dts/bindings/cpu/sifive,rocket0.yaml
```yaml
description: Rocket RISC-V CPU, as emitted by the pinned Iris elaboration
compatible: "sifive,rocket0"
include: riscv,cpus.yaml
properties:
  riscv,pmpgranularity:
    type: int
    const: 4
  riscv,pmpregions:
    type: int
    const: 8
```

## zephyr/dts/bindings/cpu/ucb-bar,shuttle.yaml
```yaml
description: UCB Shuttle RISC-V CPU, as emitted by the pinned Iris elaboration
compatible: "ucb-bar,shuttle"
include: riscv,cpus.yaml
```

## zephyr/firesim-fit-app/Kconfig
```kconfig
mainmenu "Iris SMP profiling workload"
source "Kconfig.zephyr"

config IRIS_BENCH_WORKERS
	int "Number of pinned Iris workers"
	range 1 3
	default 2
	help
	  Must match the number of set bits in IRIS_BENCH_HART_MASK. Scalar work
	  runs on every selected hart, including the Rocket hart 2.

config IRIS_BENCH_HART_MASK
	int "Participating hart mask (bit 0/1/2)"
	range 1 7
	default 3
	help
	  Select any nonempty subset of the three harts. The board port must map
	  Zephyr CPU indices to the same architectural hart IDs; the app checks
	  this at runtime. VME runs only on compute harts 0 and 1; hart 2 performs
	  vector copy work during the mixed VME case.

config IRIS_BENCH_VME
	bool "Exercise VME (requires verified board vector/tile context support)"
	default n
	depends on RISCV_ISA_EXT_V && FPU_SHARING
	help
	  Requires the derived Iris Zephyr kernel with RISCV_IRIS_VME_CONTEXT.
	  Compute workers call iris_vme_enable() explicitly before the measured
	  VME region; hart 2 runs ordinary RVV. CMake rejects missing context
	  support. This app yields while tile state is live.

config IRIS_BENCH_EXIT_ON_COMPLETION
	bool "Signal simulator completion through the board reboot hook"
	default n
	depends on REBOOT && UART_HTIF
	help
	  Acceptance-run option for the source-backed Iris board: its inherited
	  RocketChip sys_arch_reboot writes HTIF success to tohost and parks.
	  Enable only for a verified HTIF completion path, not a reboot loop.
```
