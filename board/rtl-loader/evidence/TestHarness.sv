// Generated by CIRCT firtool-1.75.0

// Users can define 'STOP_COND' to add an extra gate to stop conditions.
`ifndef STOP_COND_
  `ifdef STOP_COND
    `define STOP_COND_ (`STOP_COND)
  `else  // STOP_COND
    `define STOP_COND_ 1
  `endif // STOP_COND
`endif // not def STOP_COND_

// Users can define 'ASSERT_VERBOSE_COND' to add an extra gate to assert error printing.
`ifndef ASSERT_VERBOSE_COND_
  `ifdef ASSERT_VERBOSE_COND
    `define ASSERT_VERBOSE_COND_ (`ASSERT_VERBOSE_COND)
  `else  // ASSERT_VERBOSE_COND
    `define ASSERT_VERBOSE_COND_ 1
  `endif // ASSERT_VERBOSE_COND
`endif // not def ASSERT_VERBOSE_COND_
module TestHarness(	// @[generators/chipyard/src/main/scala/harness/TestHarness.scala:19:7]
  input  clock,	// @[generators/chipyard/src/main/scala/harness/TestHarness.scala:19:7]
  input  reset,	// @[generators/chipyard/src/main/scala/harness/TestHarness.scala:19:7]
  output io_success	// @[generators/chipyard/src/main/scala/harness/TestHarness.scala:20:14]
);

  wire        _source_1_clk;	// @[generators/chipyard/src/main/scala/harness/HarnessClocks.scala:70:26]
  wire        _source_clk;	// @[generators/chipyard/src/main/scala/harness/HarnessClocks.scala:70:26]
  wire        _harnessBinderReset_catcher_io_sync_reset;	// @[generators/rocket-chip/src/main/scala/util/ResetCatchAndSync.scala:39:28]
  wire        _success_exit_sim_tsi_in_valid;	// @[generators/testchipip/src/main/scala/tsi/SimTSI.scala:12:23]
  wire [31:0] _success_exit_sim_tsi_in_bits;	// @[generators/testchipip/src/main/scala/tsi/SimTSI.scala:12:23]
  wire        _success_exit_sim_tsi_out_ready;	// @[generators/testchipip/src/main/scala/tsi/SimTSI.scala:12:23]
  wire [31:0] _success_exit_sim_exit;	// @[generators/testchipip/src/main/scala/tsi/SimTSI.scala:12:23]
  wire        _ram_io_ser_in_ready;	// @[generators/chipyard/src/main/scala/harness/HarnessBinders.scala:269:29]
  wire        _ram_io_ser_out_valid;	// @[generators/chipyard/src/main/scala/harness/HarnessBinders.scala:269:29]
  wire [15:0] _ram_io_ser_out_bits_phit;	// @[generators/chipyard/src/main/scala/harness/HarnessBinders.scala:269:29]
  wire        _ram_io_tsi_in_ready;	// @[generators/chipyard/src/main/scala/harness/HarnessBinders.scala:269:29]
  wire        _ram_io_tsi_out_valid;	// @[generators/chipyard/src/main/scala/harness/HarnessBinders.scala:269:29]
  wire [31:0] _ram_io_tsi_out_bits;	// @[generators/chipyard/src/main/scala/harness/HarnessBinders.scala:269:29]
  wire [31:0] _plusarg_reader_1_out;	// @[generators/rocket-chip/src/main/scala/util/PlusArg.scala:80:11]
  wire        _jtag_jtag_TCK;	// @[generators/chipyard/src/main/scala/harness/HarnessBinders.scala:192:22]
  wire        _jtag_jtag_TMS;	// @[generators/chipyard/src/main/scala/harness/HarnessBinders.scala:192:22]
  wire        _jtag_jtag_TDI;	// @[generators/chipyard/src/main/scala/harness/HarnessBinders.scala:192:22]
  wire [31:0] _jtag_exit;	// @[generators/chipyard/src/main/scala/harness/HarnessBinders.scala:192:22]
  wire        _plusarg_reader_out;	// @[generators/rocket-chip/src/main/scala/util/PlusArg.scala:80:11]
  wire        _uart_sim_0_uartno0_io_uart_rxd;	// @[generators/testchipip/src/main/scala/uart/SimUART.scala:76:28]
  wire        _chiptop0_uart_0_txd;	// @[generators/chipyard/src/main/scala/harness/HasHarnessInstantiators.scala:100:40]
  wire        _chiptop0_jtag_TDO;	// @[generators/chipyard/src/main/scala/harness/HasHarnessInstantiators.scala:100:40]
  wire        _chiptop0_serial_tl_0_in_ready;	// @[generators/chipyard/src/main/scala/harness/HasHarnessInstantiators.scala:100:40]
  wire        _chiptop0_serial_tl_0_out_valid;	// @[generators/chipyard/src/main/scala/harness/HasHarnessInstantiators.scala:100:40]
  wire [15:0] _chiptop0_serial_tl_0_out_bits_phit;	// @[generators/chipyard/src/main/scala/harness/HasHarnessInstantiators.scala:100:40]
  `ifndef SYNTHESIS	// @[generators/rocket-chip/src/main/scala/devices/debug/Periphery.scala:236:11]
    always @(posedge _source_1_clk) begin	// @[generators/chipyard/src/main/scala/harness/HarnessClocks.scala:70:26, generators/rocket-chip/src/main/scala/devices/debug/Periphery.scala:236:11]
      if (~_harnessBinderReset_catcher_io_sync_reset & (|(_jtag_exit[31:1]))) begin	// @[generators/chipyard/src/main/scala/harness/HarnessBinders.scala:192:22, :193:82, generators/rocket-chip/src/main/scala/devices/debug/Periphery.scala:236:{11,20,72}, generators/rocket-chip/src/main/scala/util/ResetCatchAndSync.scala:39:28]
        if (`ASSERT_VERBOSE_COND_)	// @[generators/rocket-chip/src/main/scala/devices/debug/Periphery.scala:236:11]
          $error("Assertion failed: *** FAILED *** (exit code = %d)\n\n    at Periphery.scala:236 assert(io.exit < 2.U, \"*** FAILED *** (exit code = %%%%d)\\n\", io.exit >> 1.U)\n", {1'h0, _jtag_exit[31:1]});	// @[generators/chipyard/src/main/scala/harness/HarnessBinders.scala:192:22, generators/rocket-chip/src/main/scala/devices/debug/Periphery.scala:236:{11,72}]
        if (`STOP_COND_)	// @[generators/rocket-chip/src/main/scala/devices/debug/Periphery.scala:236:11]
          $fatal;	// @[generators/rocket-chip/src/main/scala/devices/debug/Periphery.scala:236:11]
      end
      if (~_harnessBinderReset_catcher_io_sync_reset & (|(_success_exit_sim_exit[31:1]))) begin	// @[generators/rocket-chip/src/main/scala/util/ResetCatchAndSync.scala:39:28, generators/testchipip/src/main/scala/tsi/SimTSI.scala:12:23, :20:22, :21:{11,12,62}]
        if (`ASSERT_VERBOSE_COND_)	// @[generators/testchipip/src/main/scala/tsi/SimTSI.scala:21:11]
          $error("Assertion failed: *** FAILED *** (exit code = %d)\n\n    at SimTSI.scala:21 assert(!error, \"*** FAILED *** (exit code = %%%%d)\\n\", exit >> 1.U)\n", {1'h0, _success_exit_sim_exit[31:1]});	// @[generators/testchipip/src/main/scala/tsi/SimTSI.scala:12:23, :21:{11,62}]
        if (`STOP_COND_)	// @[generators/testchipip/src/main/scala/tsi/SimTSI.scala:21:11]
          $fatal;	// @[generators/testchipip/src/main/scala/tsi/SimTSI.scala:21:11]
      end
    end // always @(posedge)
  `endif // not def SYNTHESIS
  ChipTop chiptop0 (	// @[generators/chipyard/src/main/scala/harness/HasHarnessInstantiators.scala:100:40]
    .uart_0_txd                        (_chiptop0_uart_0_txd),
    .uart_0_rxd                        (_uart_sim_0_uartno0_io_uart_rxd),	// @[generators/testchipip/src/main/scala/uart/SimUART.scala:76:28]
    .custom_boot                       (_plusarg_reader_out),	// @[generators/rocket-chip/src/main/scala/util/PlusArg.scala:80:11]
    .jtag_TCK                          (_jtag_jtag_TCK),	// @[generators/chipyard/src/main/scala/harness/HarnessBinders.scala:192:22]
    .jtag_TMS                          (_jtag_jtag_TMS),	// @[generators/chipyard/src/main/scala/harness/HarnessBinders.scala:192:22]
    .jtag_TDI                          (_jtag_jtag_TDI),	// @[generators/chipyard/src/main/scala/harness/HarnessBinders.scala:192:22]
    .jtag_TDO                          (_chiptop0_jtag_TDO),
    .jtag_reset                        (_harnessBinderReset_catcher_io_sync_reset),	// @[generators/rocket-chip/src/main/scala/util/ResetCatchAndSync.scala:39:28]
    .reset_io                          (reset),
    .clock_uncore                      (_source_clk),	// @[generators/chipyard/src/main/scala/harness/HarnessClocks.scala:70:26]
    .clock_tileClockGroup_rockettile_2 (_source_clk),	// @[generators/chipyard/src/main/scala/harness/HarnessClocks.scala:70:26]
    .clock_tap                         (/* unused */),
    .serial_tl_0_in_ready              (_chiptop0_serial_tl_0_in_ready),
    .serial_tl_0_in_valid              (_ram_io_ser_out_valid),	// @[generators/chipyard/src/main/scala/harness/HarnessBinders.scala:269:29]
    .serial_tl_0_in_bits_phit          (_ram_io_ser_out_bits_phit),	// @[generators/chipyard/src/main/scala/harness/HarnessBinders.scala:269:29]
    .serial_tl_0_out_ready             (_ram_io_ser_in_ready),	// @[generators/chipyard/src/main/scala/harness/HarnessBinders.scala:269:29]
    .serial_tl_0_out_valid             (_chiptop0_serial_tl_0_out_valid),
    .serial_tl_0_out_bits_phit         (_chiptop0_serial_tl_0_out_bits_phit),
    .serial_tl_0_clock_in              (_source_1_clk)	// @[generators/chipyard/src/main/scala/harness/HarnessClocks.scala:70:26]
  );	// @[generators/chipyard/src/main/scala/harness/HasHarnessInstantiators.scala:100:40]
  UARTAdapter uart_sim_0_uartno0 (	// @[generators/testchipip/src/main/scala/uart/SimUART.scala:76:28]
    .clock       (_source_1_clk),	// @[generators/chipyard/src/main/scala/harness/HarnessClocks.scala:70:26]
    .reset       (_harnessBinderReset_catcher_io_sync_reset),	// @[generators/rocket-chip/src/main/scala/util/ResetCatchAndSync.scala:39:28]
    .io_uart_txd (_chiptop0_uart_0_txd),	// @[generators/chipyard/src/main/scala/harness/HasHarnessInstantiators.scala:100:40]
    .io_uart_rxd (_uart_sim_0_uartno0_io_uart_rxd)
  );	// @[generators/testchipip/src/main/scala/uart/SimUART.scala:76:28]
  plusarg_reader #(
    .DEFAULT(0),
    .FORMAT("custom_boot_pin=%d"),
    .WIDTH(1)
  ) plusarg_reader (	// @[generators/rocket-chip/src/main/scala/util/PlusArg.scala:80:11]
    .out (_plusarg_reader_out)
  );	// @[generators/rocket-chip/src/main/scala/util/PlusArg.scala:80:11]
  SimJTAG #(
    .TICK_DELAY(3)
  ) jtag (	// @[generators/chipyard/src/main/scala/harness/HarnessBinders.scala:192:22]
    .clock           (_source_1_clk),	// @[generators/chipyard/src/main/scala/harness/HarnessClocks.scala:70:26]
    .reset           (_harnessBinderReset_catcher_io_sync_reset),	// @[generators/rocket-chip/src/main/scala/util/ResetCatchAndSync.scala:39:28]
    .jtag_TRSTn      (/* unused */),
    .jtag_TCK        (_jtag_jtag_TCK),
    .jtag_TMS        (_jtag_jtag_TMS),
    .jtag_TDI        (_jtag_jtag_TDI),
    .jtag_TDO_data   (_chiptop0_jtag_TDO),	// @[generators/chipyard/src/main/scala/harness/HasHarnessInstantiators.scala:100:40]
    .jtag_TDO_driven (1'h1),	// @[generators/rocket-chip/src/main/scala/devices/debug/Periphery.scala:236:11]
    .enable          (_plusarg_reader_1_out[0]),	// @[generators/rocket-chip/src/main/scala/devices/debug/Periphery.scala:230:18, generators/rocket-chip/src/main/scala/util/PlusArg.scala:80:11]
    .init_done       (~_harnessBinderReset_catcher_io_sync_reset),	// @[generators/chipyard/src/main/scala/harness/HarnessBinders.scala:193:82, generators/rocket-chip/src/main/scala/util/ResetCatchAndSync.scala:39:28]
    .exit            (_jtag_exit)
  );	// @[generators/chipyard/src/main/scala/harness/HarnessBinders.scala:192:22]
  plusarg_reader #(
    .DEFAULT(0),
    .FORMAT("jtag_rbb_enable=%d"),
    .WIDTH(32)
  ) plusarg_reader_1 (	// @[generators/rocket-chip/src/main/scala/util/PlusArg.scala:80:11]
    .out (_plusarg_reader_1_out)
  );	// @[generators/rocket-chip/src/main/scala/util/PlusArg.scala:80:11]
  SerialRAM ram (	// @[generators/chipyard/src/main/scala/harness/HarnessBinders.scala:269:29]
    .clock                (_source_1_clk),	// @[generators/chipyard/src/main/scala/harness/HarnessClocks.scala:70:26]
    .reset                (_harnessBinderReset_catcher_io_sync_reset),	// @[generators/rocket-chip/src/main/scala/util/ResetCatchAndSync.scala:39:28]
    .io_ser_in_ready      (_ram_io_ser_in_ready),
    .io_ser_in_valid      (_chiptop0_serial_tl_0_out_valid),	// @[generators/chipyard/src/main/scala/harness/HasHarnessInstantiators.scala:100:40]
    .io_ser_in_bits_phit  (_chiptop0_serial_tl_0_out_bits_phit),	// @[generators/chipyard/src/main/scala/harness/HasHarnessInstantiators.scala:100:40]
    .io_ser_out_ready     (_chiptop0_serial_tl_0_in_ready),	// @[generators/chipyard/src/main/scala/harness/HasHarnessInstantiators.scala:100:40]
    .io_ser_out_valid     (_ram_io_ser_out_valid),
    .io_ser_out_bits_phit (_ram_io_ser_out_bits_phit),
    .io_tsi_in_ready      (_ram_io_tsi_in_ready),
    .io_tsi_in_valid      (_success_exit_sim_tsi_in_valid),	// @[generators/testchipip/src/main/scala/tsi/SimTSI.scala:12:23]
    .io_tsi_in_bits       (_success_exit_sim_tsi_in_bits),	// @[generators/testchipip/src/main/scala/tsi/SimTSI.scala:12:23]
    .io_tsi_out_ready     (_success_exit_sim_tsi_out_ready),	// @[generators/testchipip/src/main/scala/tsi/SimTSI.scala:12:23]
    .io_tsi_out_valid     (_ram_io_tsi_out_valid),
    .io_tsi_out_bits      (_ram_io_tsi_out_bits)
  );	// @[generators/chipyard/src/main/scala/harness/HarnessBinders.scala:269:29]
  SimTSI #(
    .CHIPID(0)
  ) success_exit_sim (	// @[generators/testchipip/src/main/scala/tsi/SimTSI.scala:12:23]
    .clock         (_source_1_clk),	// @[generators/chipyard/src/main/scala/harness/HarnessClocks.scala:70:26]
    .reset         (_harnessBinderReset_catcher_io_sync_reset),	// @[generators/rocket-chip/src/main/scala/util/ResetCatchAndSync.scala:39:28]
    .tsi_in_ready  (_ram_io_tsi_in_ready),	// @[generators/chipyard/src/main/scala/harness/HarnessBinders.scala:269:29]
    .tsi_in_valid  (_success_exit_sim_tsi_in_valid),
    .tsi_in_bits   (_success_exit_sim_tsi_in_bits),
    .tsi_out_ready (_success_exit_sim_tsi_out_ready),
    .tsi_out_valid (_ram_io_tsi_out_valid),	// @[generators/chipyard/src/main/scala/harness/HarnessBinders.scala:269:29]
    .tsi_out_bits  (_ram_io_tsi_out_bits),	// @[generators/chipyard/src/main/scala/harness/HarnessBinders.scala:269:29]
    .exit          (_success_exit_sim_exit)
  );	// @[generators/testchipip/src/main/scala/tsi/SimTSI.scala:12:23]
  ResetCatchAndSync_d3 harnessBinderReset_catcher (	// @[generators/rocket-chip/src/main/scala/util/ResetCatchAndSync.scala:39:28]
    .clock         (_source_1_clk),	// @[generators/chipyard/src/main/scala/harness/HarnessClocks.scala:70:26]
    .reset         (reset),
    .io_sync_reset (_harnessBinderReset_catcher_io_sync_reset)
  );	// @[generators/rocket-chip/src/main/scala/util/ResetCatchAndSync.scala:39:28]
  ClockSourceAtFreqMHz #(
    .PERIOD(2.000000e+00)
  ) source (	// @[generators/chipyard/src/main/scala/harness/HarnessClocks.scala:70:26]
    .power (1'h1),	// @[generators/rocket-chip/src/main/scala/devices/debug/Periphery.scala:236:11]
    .gate  (1'h0),
    .clk   (_source_clk)
  );	// @[generators/chipyard/src/main/scala/harness/HarnessClocks.scala:70:26]
  ClockSourceAtFreqMHz #(
    .PERIOD(1.000000e+01)
  ) source_1 (	// @[generators/chipyard/src/main/scala/harness/HarnessClocks.scala:70:26]
    .power (1'h1),	// @[generators/rocket-chip/src/main/scala/devices/debug/Periphery.scala:236:11]
    .gate  (1'h0),
    .clk   (_source_1_clk)
  );	// @[generators/chipyard/src/main/scala/harness/HarnessClocks.scala:70:26]
  assign io_success = _success_exit_sim_exit == 32'h1 | _jtag_exit == 32'h1;	// @[generators/chipyard/src/main/scala/harness/HarnessBinders.scala:184:24, :192:22, :273:{28,56}, generators/chipyard/src/main/scala/harness/TestHarness.scala:19:7, generators/rocket-chip/src/main/scala/devices/debug/Periphery.scala:235:26, generators/testchipip/src/main/scala/tsi/SimTSI.scala:12:23, :19:24]
endmodule

